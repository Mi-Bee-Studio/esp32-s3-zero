## blink/sdkconfig.defaults
```kconfig
## esp32-s3-zero（WS2812 在 GPIO21；板子信息见 ../README.md）
CONFIG_IDF_TARGET="esp32s3"

# 控制台走原生 USB-Serial-JTAG（无 USB-UART 桥）
CONFIG_ESP_CONSOLE_USB_SERIAL_JTAG=y

CONFIG_FREERTOS_HZ=1000

# 4MB flash：OTA 双槽（app 偏移 0x20000，web 刷机写备用槽→重启切换）
CONFIG_ESPTOOLPY_FLASHSIZE_4MB=y
CONFIG_PARTITION_TABLE_CUSTOM=y
CONFIG_PARTITION_TABLE_CUSTOM_FILENAME="partitions.csv"

# 任务看门狗超时触发 panic 重启（主循环 1s 一拍喂狗）
CONFIG_ESP_TASK_WDT_PANIC=y

# S3FH4R2 的 2MB Octal PSRAM
CONFIG_SPIRAM=y
CONFIG_SPIRAM_MODE_OCT=y
CONFIG_SPIRAM_SPEED_80M=y

# 满频运行
CONFIG_ESP_DEFAULT_CPU_FREQ_MHZ_240=y
```
